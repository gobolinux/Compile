## tools/Bootstrap/Config.in
```kconfig
#
# Bootstrap configuration file
# Author: Lucas Correia Villa Real <lucasvr@gobolinux.org>
#

mainmenu "Bootstrap - GoboLinux From Scratch"

#############################################
menu "Build options"
#############################################
config HAVE_DOT_CONFIG
    bool
    default y

choice
	prompt "Cross-Compiling"
	default NATIVE_COMPILING

config NATIVE_COMPILING
	prompt "Native compiling"
	bool
	---help---
	  Do not cross-compile: generate a distribution suitable to the same 
	  platform you're running this script on.
	  
config CROSS_ARM
	prompt "ARM target"
	bool
	---help---
	  Run a toolchain to generate a distribution suitable for ARM processors.

config CROSS_ARM_SOFT_FLOAT
	prompt "Soft-Float ARM target"
	bool
	---help---
	  Run a toolchain to generate a distribution suitable for ARM processors
	  based on GCC's soft-float library. Use this if you have a working
	  Cross-ARM-SoftFP.conf and your platform doesn't have a FPU.

config CROSS_SH4
	prompt "SH-4 target"
	bool
	---help---
	  Run a toolchain to generate a distribution suitable for SH-4 processors.
	
endchoice

choice
    prompt "ARM implementation"
    depends on CROSS_ARM
    default ARM_SIRIUSTAR

config ARM_SIRIUSTAR
    prompt "SiriuStar board"
    bool

config ARM_GP32
    prompt "GP32 handheld"
    bool

endchoice

choice
    prompt "SH4 implementation"
    depends on CROSS_SH4
    default SH4_STI5528

config SH4_ST5528
    prompt "STi5528 - Espresso Board"
    bool

config SH4_ST7100
    prompt "ST7100 - CoCo Board"
    bool

endchoice

choice
	prompt "Target profile"
	default TARGET_EMBEDDED

config TARGET_EMBEDDED
	prompt "Embedded platform"
	bool
	---help---
	  Select this if the distribution is going to be generated to be used on
	  an embedded platform. This will reduce a lot the number of packages to
	  be compiled, given that no development tools will be available on it.

config TARGET_DESKTOP
	prompt "Desktop platform"
	bool
	---help---
	  Select this if the distribution is going to be generated to be used on
	  a desktop system.
      
endchoice

choice
    prompt "Network interface"
    default NETWORK_DHCP

config NETWORK_DISABLED
    prompt "Disabled"
    bool

config NETWORK_DHCP
    prompt "DHCP configuration"
    bool

config NETWORK_STATIC
    prompt "Manual configuration"
    bool

endchoice

config NETWORK_IPADDR
    string "IP address"
    default "192.168.1.110"
    depends on NETWORK_STATIC

config NETWORK_NETMASK
    string "Network mask"
    default "255.255.255.0"
    depends on NETWORK_STATIC

config NETWORK_DEFAULT_GATEWAY
    string "Default gateway"
    default "192.168.1.1"
    depends on NETWORK_STATIC

config NETWORK_NAMESERVER
    string "Primary nameserver"
    default "192.168.1.1"
    depends on NETWORK_STATIC

comment ""

config KERNEL_HEADERS_VERSION
	string "Kernel version for Linux-Headers package"
	default "2.6.19"
	---help---
	  Specifies which kernel version to use for Linux-Headers package
	  generation.

config NEW_HOSTNAME
    string "Hostname"
    default "GoboLinux"

config SUPER_USER_NAME
    string "Super-user name"
    default "root"
	---help---
	  Allows to select a different super-user name instead of "root".

endmenu # "Build options"

#############################################
menu "Base system"
#############################################
choice
    prompt "Libc implementation"
    default PKG_GLIBC

config NO_LIBC
    bool "Do not compile a libc package"
    ---help---
      Only choose this if you already have a binary package of a libc
      implementation, or if you're going to create a small distribution
      based on static packages from your toochain's libc.

source "packages/Glibc/Config.in"
source "packages/UClibc/Config.in"
endchoice

source "packages/Module-Init-Tools/Config.in"
source "packages/BusyBox/Config.in"
source "packages/LibGCC/Config.in"
source "packages/LibStdC++/Config.in"
source "packages/ZLib/Config.in"
source "packages/GPM/Config.in"
source "packages/GoboHide/Config.in"
source "packages/Listener/Config.in"
source "packages/Udev/Config.in"
comment ""
# source "packages/Pkgconfig/Config.in"
source "packages/Ncurses/Config.in"
source "packages/Bash/Config.in"
endmenu

#############################################
menu "Development"
#############################################
source "packages/LibTool/Config.in"
source "packages/Make/Config.in"
#source "packages/GMP/Config.in"
#source "packages/GCC/Config.in"
#source "packages/TCC/Config.in"
source "packages/Strace/Config.in"
endmenu

#############################################
menu "Fonts and XML parsers"
#############################################
source "packages/Expat/Config.in"
source "packages/LibXML2/Config.in"
source "packages/FreeType/Config.in"
source "packages/Fontconfig/Config.in"
endmenu

#############################################
menu "Audio"
#############################################
source "packages/ALSA-Lib/Config.in"
source "packages/ALSA-Utils/Config.in"
source "packages/LibMad/Config.in"
source "packages/LibOGG/Config.in"
source "packages/LibVorbis/Config.in"
source "packages/LibID3Tag/Config.in"
source "packages/Madplay/Config.in"
source "packages/GQmpeg/Config.in"
endmenu

#############################################
menu "Networking and Communications"
#############################################
source "packages/OpenSSL/Config.in"
source "packages/OpenSSH/Config.in"
source "packages/LZO/Config.in"
source "packages/OpenVPN/Config.in"
source "packages/Links/Config.in"
source "packages/Minicom/Config.in"
source "packages/PPP/Config.in"
endmenu

#############################################
menu "X servers"
#############################################
source "packages/Xorg/Config.in"
source "packages/Nano-X/Config.in"
endmenu

#############################################
menu "Video and graphics"
#############################################
source "packages/JPEG/Config.in"
source "packages/LibPNG/Config.in"
source "packages/LibUngif/Config.in"
source "packages/Linux-Fusion/Config.in"
source "packages/DirectFB/Config.in"
source "packages/TIFF/Config.in"
source "packages/SDL/Config.in"
source "packages/SDL_ttf/Config.in"
source "packages/SDL_mixer/Config.in"
source "packages/SVGALib/Config.in"
source "packages/IMLib/Config.in"
source "packages/FFmpeg-Motion/Config.in"
endmenu

#############################################
menu "GTK+ suite"
#############################################
source "packages/Gettext/Config.in"
source "packages/GLib/Config.in"
source "packages/Cairo/Config.in"
source "packages/ATK/Config.in"
source "packages/Pango/Config.in"
source "packages/GTK+/Config.in"
source "packages/Dbus/Config.in"
endmenu

#############################################
menu "Misc"
#############################################
source "packages/Startup-Notification/Config.in"
source "packages/MTD-Utils/Config.in"
source "packages/LibUSB/Config.in"
source "packages/Lirc/Config.in"
source "packages/E2FSProgs/Config.in"
source "packages/ReiserFSProgs/Config.in"
source "packages/Shared-Mime-INFO/Config.in"
source "packages/Htop/Config.in"
source "packages/M4/Config.in"
source "packages/Flex/Config.in"
source "packages/Bison/Config.in"
source "packages/BC/Config.in"
comment ""
source "packages/A2PS/Config.in"
comment ""
source "packages/Mowitz/Config.in"
source "packages/LibART_LGPL/Config.in"
source "packages/LibOIL/Config.in"
source "packages/LibIDL/Config.in"
comment ""
source "packages/Gnokii/Config.in"
source "packages/Motion/Config.in"
endmenu    

#############################################
menu "Desktop"
#############################################
comment "Window Managers"
#source "packages/Matchbox/Config.in"
source "packages/XFCE/Config.in"
source "packages/IceWM/Config.in"
comment "Applications"
#source "packages/ROX-Filer/Config.in"
source "packages/RXVT/Config.in"
source "packages/Mrxvt/Config.in"
source "packages/Siag/Config.in"
source "packages/Swfdec/Config.in"
endmenu


#############################################
menu "Shrink Options"
#############################################
depends on TARGET_EMBEDDED
config SHRINK_ALL
    bool "Remove and shrink as much as possible"
    select SHRINK_HEADERS
    select SHRINK_STATIC_LIBS
    select SHRINK_LIBTOOL
    select SHRINK_PKGCONFIG
    select SHRINK_DOCS
    select SHRINK_LOCALES
    select SHRINK_M4_MACROS
    select SHRINK_STRIP_ALL
	---help---
	  Removes headers, static libs, libtool, pkgconfig, locales and M4
	  data. Also removes documentation, strips all libraries and
	  executables found on each package, and performs an additional
	  cleanup based on per-package scripts found in the subdirectories
	  inside 'packages/'.
	  
	  Please note that this action isn't taken automatically. In order
	  to effectivelly shrink the filesystem, you must type 'make shrink'
	  in the command line, which will still make a backup of the generated
	  filesystem prior to removing its contents.

config SHRINK_HEADERS
	bool "Remove headers"
	---help---
	  Removes headers found on each package, needed only at compile time. To
	  perform the removal, you still must type 'make shrink' in the command
	  line, which will make a backup of the generated filesystem prior to
	  removing its contents.
    
config SHRINK_STATIC_LIBS
	bool "Remove static libraries"
	---help---
	  Removes static libs found on each package, needed only at compile time
	  by some programs. To perform the removal, you still must type 'make shrink'
	  in the command line, which will make a backup of the generated filesystem
	  prior to removing its contents.
    
config SHRINK_LIBTOOL
	bool "Remove libtool related files"
	---help---
	  Removes libtool files found on each package, used at compile time by
	  some programs. To perform the removal, you still must type 'make shrink'
	  in the command line, which will make a backup of the generated filesystem
	  prior to removing its contents.
    
config SHRINK_PKGCONFIG
	bool "Remove pkgconfig related files"
	---help---
	  Removes pkgconfig files found on each package, used at compile time by
	  some programs. To perform the removal, you still must type 'make shrink'
	  in the command line, which will make a backup of the generated filesystem
	  prior to removing its contents.
    
config SHRINK_DOCS
	bool "Remove documentation"
	---help---
	  Removes documentation (man, info, docs) found on each package. To perform
	  the removal, you still must type 'make shrink' in the command line, which
	  will make a backup of the generated filesystem prior to removing its
	  contents.
    
config SHRINK_DEFAULT_SETTINGS
	bool "Remove backup of the default settings"
	---help---
	  Removes backup of the default settings for each package. Please note that
	  this is not recommended, as these files usually take only a few bytes and
	  are very helpful on recovering from problems on settings files. To perform
	  the removal, you still must type 'make shrink' in the command line, which
	  will make a backup of the generated filesystem prior to removing its
	  contents.
    
config SHRINK_LOCALES
	bool "Remove internationalization files"
	---help---
	  Removes i18n data, used by programs to display messages in other languages.
	  than english. To perform the removal, you still must type 'make shrink' in
	  the command line, which will make a backup of the generated filesystem prior
	  to removing its contents.
    
config SHRINK_M4_MACROS
	bool "Remove aclocal macros"  
	---help---
	  Removes aclocal macros, used at compile time by some programs. To perform
	  the removal, you still must type 'make shrink' in the command line, which
	  will make a backup of the generated filesystem prior to removing its
	  contents.

choice
	prompt "Removal of symbols"
    default SHRINK_STRIP_ALL

config SHRINK_STRIP_ALL
	bool "All symbols from executables and libraries"
	---help---
	  Removes all symbols which aren't strictly necessary to get the program
	  running. This will make it impossible to use the libraries for linkage,
	  and will also remove relocation information on them. To perform the
	  removal, you still must type 'make shrink' in the command line, which
	  will make a backup of the generated filesystem prior to removing its
	  contents.

config SHRINK_STRIP_UNNEEDED
	bool "All symbols not needed by relocations"
	---help---
	  Removes symbols from files, keeping only symbols used by relocations.
	  To perform the removal, you still must type 'make shrink' in the
	  command line, which will make a backup of the generated filesystem
	  prior to removing its contents.

config SHRINK_STRIP_IGNORE
	bool "Don't strip anything"
	---help---
	  Let the files stay fat with all symbols they already have.

endchoice

menu "Native language support"
config NLS_ISO8859_1
    prompt "ISO8859-1 (Western European Languages)"
    bool
    default y
    ---help---
      Say Y here to keep support for the Latin 1 character set, which covers
      most West European languages such as Albanian, Catalan, Danish, Dutch, 
      English, Faeroese, Finnish, French, German, Galician, Irish, Icelandic,
      Italian, Norwegian, Portuguese, Spanish, and Swedish. It is also the 
      default for the US. If unsure, say Y.

config NLS_ISO8859_2
    prompt "ISO8859-2 (Slavic/Central European Languages)"
    bool
    default n
    ---help---
      Say Y here to keep support for the Latin 2 character set, which works for 
      most Latin-written Slavic and Central European languages: Czech, German,
      Hungarian, Polish, Rumanian, Croatian, Slovak, Slovene.

config NLS_ISO8859_3
    prompt "ISO8859-3 (Esperanto, Galician, Maltese, Turkish)"
    bool
    default n
    ---help---
      Say Y here to keep support for the Latin 3 character set, which is popular
      with authors of Esperanto, Galician, Maltese and Turkish.

config NLS_ISO8859_4
    prompt "ISO8859-4 (Old Baltic charset)"
    bool
    default n
    ---help---
      Say Y here to keep support for the Latin 4 character set, which introduces
      letters for Estonian, Latvian, and Lithuanian. It is an incomplete 
      predecessor of Latin 7.

config NLS_ISO8859_5
    prompt "ISO8859-5 (Cyrillic)"
    bool
    default n
    ---help---
      Say Y here to keep support for the Latin 5 character set, which you can
      type Bulgarian, Belarusian, Macedonian, Russian, Serbian, and Ukrainian.
      Note that the charset KOI8-R is preferred in Russia.

config NLS_ISO8859_6
    prompt "ISO8859-6 (Arabic)"
    bool
    default n
    ---help---
      Say Y here to keep support for ISO8859-6, the Arabic character set.

config NLS_ISO8859_7
    prompt "ISO8859-7 (Modern Greek)"
    bool
    default n
    ---help---
      Say Y here to keep support for ISO8859-7, the Greek character set. 

config NLS_ISO8859_9
    prompt "ISO8859-9 (Turkish)"
    bool
    default n
    ---help---
      Say Y here to keep support for the Latin 5 character set, which replaces
      the rarely needed Icelandic letters in Latin 1 with the Turkish ones.
      Useful in Turkey.

config NLS_ISO8859_13
    prompt "ISO8859-13 (Baltic)"
    bool
    default n
    ---help---
      Say Y here to keep support for the Latin 7 character set, which supports
      modern Baltic languages including Latvian and Lithuanian.

config NLS_ISO8859_14
    prompt "ISO8859-14 (Celtic)"
    bool
    default n
    ---help---
      Say Y here to keep support for the Latin 8 character set, which adds the
      last accented vowels for Welsh (aka Cymraeg) (and Manx Gaelic) that were
      missing in Latin 1.
      <http://linux.speech.cymru.org/> has further information.

config NLS_ISO8859_15
    prompt "ISO8859-15 (Western European Languages with Euro)"
    bool
    default y
    ---help---
      Say Y here to keep support for the Latin 9 character set, which covers
      most West European languages such as Albanian, Catalan, Danish, Dutch,
      English, Estonian, Faeroese, Finnish, French, German, Galician, Irish,
      Icelandic, Italian, Norwegian, Portuguese, Spanish, and Swedish. Latin 9
      is an update to Latin 1 (ISO 8859-1) that removes a handful of rarely used
      characters and instead adds support for Estonian, corrects the support for
      French and Finnish, and adds the new Euro character.
      If unsure, say Y.

config NLS_KOI8_R
    prompt "KOI8-R (Russian)"
    bool
    default n
    ---help---
      Say Y here to keep support for the preferred Russian character set.

config NLS_JISX0201
    prompt "JISX0201 (Japanese)"
    bool
    default n
    ---help---
      Say Y here to keep support for the JISX0201 character set, which defines
      control characters, ascii characters (#x01 through #x7e) and 'hankaku' 
      characters (#xa1 through #xdf) for the Japanese language.

endmenu # NLS
endmenu # Shrink options
```
