## tools/Bootstrap/packages/LibStdC++/Config.in
```kconfig
config PKG_LIBSTDC
    bool "LibStdC++"
    depends on !PKG_GCC && !NATIVE_COMPILING
    default y
    ---help---
      This library is needed by C++ applications cross-compiled for the target
      platform and when the C compiler isn't going to be available on the final
      filesystem.
	  
      Say Y, unless your system is going to contain only the libc and BusyBox.
```
