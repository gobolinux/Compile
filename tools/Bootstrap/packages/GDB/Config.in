## tools/Bootstrap/packages/GMP/Config.in
```kconfig
config PKG_GMP
    bool "GMP arbitrary precision arithmetic library"
    default n
```

## tools/Bootstrap/packages/LibGCC/Config.in
```kconfig
config PKG_LIBGCC
    bool "LibGCC"
    depends on !PKG_GCC && !NATIVE_COMPILING
    default y
    ---help---
      This library is needed by applications generated by the cross-compiler.
      Say Y, unless your system is going to contain only the libc and BusyBox.
```
