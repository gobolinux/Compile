## tools/Bootstrap/packages/Xorg-Lib/Config.in
```kconfig
config PKG_XORG_LIB
    bool "Xorg-Lib"
    ---help---
      This option installs the Xorg libraries, which are needed by many 
      applications, including Xorg itself. Say Y if you're building a
      desktop system.
```

## tools/ScratchBox/packages/BusyBox/Config.in
```kconfig
config PKG_BUSYBOX
    bool "BusyBox"
    default y
    ---help---
      This selects a lot of useful tools that you're going to need if you're
      creating a small system. Unless you are creating a system for the 
      desktop, say Y here.
```

## tools/ScratchBox/packages/Dbus/Config.in
```kconfig
config PKG_DBUS
    bool "DBus"
    select PKG_EXPAT 
    select PKG_GETTEXT 
    select PKG_XORG_LIB
```

## tools/ScratchBox/packages/Fontconfig/Config.in
```kconfig
config PKG_FONTCONFIG
    bool "Fontconfig"
    select PKG_EXPAT 
    select PKG_FREETYPE
```

## tools/ScratchBox/packages/Glibc/Config.in
```kconfig
config PKG_GLIBC
    bool "Glibc"
    default y
    ---help---
      This selects the Glibc library. Unless you're recompiling your system
      and you already have it installed on your target's directory and you are
      very sure about what you're doing, say Y here.
```

## tools/ScratchBox/packages/Listener/Config.in
```kconfig
config PKG_LISTENER
    bool "Listener"
    default y
    ---help---
      This program helps to perform automatic system management tasks, such as
      removing broken links when a program is removed, or installing a package
      when it's moved into /Programs.
```

## tools/ScratchBox/packages/Shared-Mime-INFO/Config.in
```kconfig
config PKG_SHARED_MIME_INFO
    bool "Shared-Mime-Info"
    select PKG_GLIB
    select PKG_GETTEXT 
    select PKG_LIBXML2
```
